
#include <SPI.h>
#include <Wire.h>
#include <Adafruit_GFX.h>
#include <Adafruit_SSD1306.h>

#define SCREEN_WIDTH 128 // OLED display width, in pixels
#define SCREEN_HEIGHT 64 // OLED display height, in pixels

#define OLED_RESET     4 // Reset pin # (or -1 if sharing Arduino reset pin)
#define SCREEN_ADDRESS 0x3C ///< See datasheet for Address; 0x3D for 128x64, 0x3C for 128x32
Adafruit_SSD1306 display(SCREEN_WIDTH, SCREEN_HEIGHT, &Wire, OLED_RESET);

#define MAX_MESSAGE_LENGTH 50
#include <stdint.h>



const unsigned char frame1 [] PROGMEM = {
  0x00, 0x00, 0x00, 0x00, 0x00, 0x00, 0x00, 0x00, 0x00, 0x00, 0x00, 0x00, 0x00, 0x00, 0x00, 0x00, 
  0x00, 0x00, 0x07, 0x76, 0x20, 0x00, 0x00, 0x00, 0x00, 0x77, 0x50, 0x1d, 0xd8, 0x00, 0x1d, 0xd1, 
  0x06, 0x06, 0x04, 0x55, 0x60, 0x00, 0x00, 0x00, 0x00, 0x45, 0x50, 0x11, 0x54, 0x00, 0x15, 0x5b, 
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  0x00, 0x00, 0x00, 0x00, 0x00, 0x00, 0x00, 0x00, 0x07, 0xff, 0xf8, 0x00, 0x00, 0x00, 0x00, 0x00
};



const unsigned char frame2 [] PROGMEM = {
  0x00, 0x00, 0x00, 0x00, 0x00, 0x00, 0x00, 0x00, 0x00, 0x00, 0x00, 0x00, 0x00, 0x00, 0x00, 0x00, 
  0x00, 0x00, 0x07, 0x76, 0x20, 0x00, 0x00, 0x00, 0x00, 0x77, 0x50, 0x1d, 0xd8, 0x00, 0x1d, 0xd1, 
  0x03, 0xe0, 0x04, 0x55, 0x60, 0x00, 0x00, 0x00, 0x00, 0x45, 0x50, 0x11, 0x54, 0x00, 0x15, 0x5b, 
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  0x00, 0x00, 0x00, 0x00, 0x00, 0x00, 0x00, 0x00, 0x07, 0xff, 0xf8, 0x00, 0x00, 0x00, 0x00, 0x00
};


const unsigned char frame3 [] PROGMEM = {
  0x00, 0x00, 0x00, 0x00, 0x00, 0x00, 0x00, 0x00, 0x00, 0x00, 0x00, 0x00, 0x00, 0x00, 0x00, 0x00, 
  0x00, 0x00, 0x07, 0x76, 0x20, 0x00, 0x00, 0x00, 0x11, 0x77, 0x50, 0x1d, 0xd8, 0x00, 0x1d, 0xd1, 
  0x00, 0x3f, 0x04, 0x55, 0x60, 0x00, 0x00, 0x00, 0x22, 0x45, 0x50, 0x11, 0x54, 0x00, 0x15, 0x5b, 
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  0x00, 0x00, 0x00, 0x00, 0x00, 0x00, 0x00, 0x00, 0x07, 0xff, 0xf8, 0x00, 0x00, 0x00, 0x00, 0x00
};




void setup() {
  Serial.begin(115200);
  Serial.setTimeout(50); 
  // SSD1306_SWITCHCAPVCC = generate display voltage from 3.3V internally
  if (!display.begin(SSD1306_SWITCHCAPVCC, SCREEN_ADDRESS)) {
    Serial.println(F("SSD1306 allocation failed"));
    for (;;); // Don't proceed, loop forever
  }
  display.display();
  delay(2000); // Pause for 2 seconds
  // Clear the buffer
  display.clearDisplay();
  
  
}

String message;
void loop() {
  //check if new data is available to be read
  if(Serial.available()){
   message = Serial.readString();
  }
  //FRAME 1
  display.clearDisplay();
  display.drawBitmap(0, 0, frame1, 128, 64, SSD1306_WHITE);
  draw_message(message);
  display.display();
  delay(50);
  //FRAME 2
  display.clearDisplay();
  display.drawBitmap(0, 0, frame2, 128, 64, SSD1306_WHITE);
  draw_message(message);
  display.display();
  delay(50);
  //FRAME 3
  display.clearDisplay();
  display.drawBitmap(0, 0, frame3, 128, 64, SSD1306_WHITE);
  draw_message(message);
  display.display();
  delay(50);

}

//Function to draw a string on the display at the x,y coordinates
void drawchar(char * value,int x,int y) {
  display.setTextSize(1);      // Normal 1:1 pixel scale
  display.setTextColor(SSD1306_WHITE); // Draw white text
  display.setCursor(x, y);     // Start at top-left corner
  display.cp437(true);         // Use full 256 char 'Code Page 437' font

  display.write(value);
}

//Function to decode incoming message with stats
//Message template: "fan1:fan2:fan3:cputemp:gputemp:cpuload:cpupower:cpufan"
void draw_message(String message){
  int message_type = 0;
  int x=0,y=0;
  char value[5];

  
  for(int i = 0; i < MAX_MESSAGE_LENGTH;i++){
    char letter[2];
    letter[0] = message[i];
    letter[1] = '\0';
    
    if(message[i] == '\n'){
      drawchar(value,x,y);
      break;
    }
    if(message[i] == ':'){
      drawchar(value,x,y);
      message_type++;
      value[0] = '\0';
    }else if(message_type == 0){//fan1
      x = 21;
      y = 14;
      strcat(value, letter);
    }else if(message_type == 1){//fan2
      x = 21;
      y = 35;
      strcat(value, letter);
    }else if(message_type == 2){//fan3
      x = 21;
      y = 57;
      strcat(value, letter);
    }else if(message_type == 3){//cpu temp
      x = 75;
      y = 11;
      strcat(value, letter);
    }else if(message_type == 4){//gpu temp
      x = 111;
      y = 52;
      strcat(value, letter);
    }else if(message_type == 5){//cpu load
      x = 104;
      y = 18;
      strcat(value, letter);
    }else if(message_type == 6){//cpu power
      x = 75;
      y = 27;
      strcat(value, letter);
    }else if(message_type == 7){//cpu fan
      x = 94;
      y = 9;
      strcat(value, letter);
    }
    
  }
}
